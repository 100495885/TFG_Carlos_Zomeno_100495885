## CMakeLists.txt
```
cmake_minimum_required(VERSION 3.20.0)

if(EXISTS ${CMAKE_CURRENT_SOURCE_DIR}/secrets.conf)
    set(EXTRA_CONF_FILE "secrets.conf")
endif()

find_package(Zephyr REQUIRED HINTS $ENV{ZEPHYR_BASE})

project(agente_predictivo)

target_sources(app PRIVATE
    src/main.c
    src/cJSON.c
    src/features.c
    src/baseline.c
    src/policy.c
    src/report.c
    src/llm_client.c
    src/sensors.c
)

target_include_directories(app PRIVATE src)
```

## Kconfig
```
mainmenu "Agente Predictivo ESP32-S3"

config GEMINI_API_KEY
    string "API Key de Google Gemini"
    default ""

config WIFI_SSID
    string "SSID de la red WiFi"
    default ""

config WIFI_PASSWORD
    string "Contraseña de la red WiFi"
    default ""

source "Kconfig.zephyr"
```

## prj.conf
```kconfig
# CPU y memoria
CONFIG_HEAP_MEM_POOL_SIZE=139264
CONFIG_MAIN_STACK_SIZE=24576

# WiFi
CONFIG_WIFI=y
CONFIG_NET_L2_ETHERNET=y
CONFIG_ESP32_WIFI_STATIC_RX_BUFFER_NUM=4
CONFIG_ESP32_WIFI_DYNAMIC_RX_BUFFER_NUM=8
CONFIG_ESP32_WIFI_DYNAMIC_TX_BUFFER_NUM=8

# Red TCP/IP
CONFIG_NETWORKING=y
CONFIG_NET_IPV4=y
CONFIG_NET_TCP=y
CONFIG_NET_SOCKETS=y
CONFIG_NET_DHCPV4=y

CONFIG_DNS_RESOLVER=y
CONFIG_DNS_SERVER_IP_ADDRESSES=y
CONFIG_DNS_SERVER1="8.8.8.8"

# HTTPS / TLS
CONFIG_MBEDTLS=y
CONFIG_MBEDTLS_BUILTIN=y
CONFIG_MBEDTLS_ENABLE_HEAP=y
CONFIG_MBEDTLS_HEAP_SIZE=40960
CONFIG_MBEDTLS_CIPHERSUITE_TLS_ECDHE_RSA_WITH_AES_128_GCM_SHA256=y
CONFIG_MBEDTLS_CIPHERSUITE_TLS_ECDHE_ECDSA_WITH_AES_128_GCM_SHA256=y
CONFIG_PSA_WANT_ECC_SECP_R1_256=y
CONFIG_PSA_WANT_KEY_TYPE_ECC_PUBLIC_KEY=y
CONFIG_NET_SOCKETS_SOCKOPT_TLS=y
CONFIG_NET_SOCKETS_TLS_MAX_CLIENT_SESSION_COUNT=0
CONFIG_MBEDTLS_SSL_IN_CONTENT_LEN=16384
CONFIG_MBEDTLS_SSL_OUT_CONTENT_LEN=4096

# Sistema de ficheros LittleFS
CONFIG_FILE_SYSTEM=y
CONFIG_FILE_SYSTEM_LITTLEFS=y
CONFIG_FLASH=y
CONFIG_FLASH_MAP=y

# Consola serie
CONFIG_SERIAL=y
CONFIG_UART_CONSOLE=y
CONFIG_CBPRINTF_FP_SUPPORT=y

# Logging
CONFIG_LOG=y
CONFIG_LOG_DEFAULT_LEVEL=3
CONFIG_LOG_MODE_IMMEDIATE=y
CONFIG_NET_LOG=y
CONFIG_NET_SOCKETS_LOG_LEVEL_WRN=y
CONFIG_MBEDTLS_LOG_LEVEL_ERR=y

# Shell (consola serie, mismo UART que el log)
CONFIG_SHELL=y
CONFIG_SHELL_BACKEND_SERIAL=y
CONFIG_SHELL_LOG_BACKEND=y
CONFIG_FILE_SYSTEM_SHELL=y
```

## src/main.c
```c
// main.c — agent.c adaptado para Zephyr OS en ESP32-S3
#include <zephyr/fs/fs.h>
#include <zephyr/fs/littlefs.h>
#include <zephyr/kernel.h>
#include <zephyr/logging/log.h>
#include <zephyr/net/dhcpv4.h>
#include <zephyr/net/net_if.h>
#include <zephyr/net/net_mgmt.h>
#include <zephyr/net/wifi_mgmt.h>

#include <math.h>
#include <stdio.h>
#include <stdlib.h>
#include <string.h>

#include "cJSON.h"

#include "features.h"
#include "llm_client.h"
#include "policy.h"
#include "report.h"
#include "sensors.h"

LOG_MODULE_REGISTER(agente, LOG_LEVEL_INF);

#define DEVICE_ID "motor-01"
#define ALARM_FOLDER "/lfs/ALARM"
#define FS_HZ 2000.0f
#define N_SAMPLES 512

static uint32_t alarm_counter = 0;

static float ax[N_SAMPLES];
static float ay[N_SAMPLES];
static float az[N_SAMPLES];
static float mag[N_SAMPLES];

// WiFi
// Semáforo que el callback sube cuando llega el evento de conexión.
// main() bloquea en k_sem_take() hasta entonces (máx. 30 s).

static K_SEM_DEFINE(wifi_connected, 0, 1);
static K_SEM_DEFINE(ip_obtained, 0, 1);
static struct net_mgmt_event_callback wifi_cb;
static struct net_mgmt_event_callback dhcp_cb;

static void wifi_event_handler(struct net_mgmt_event_callback *cb,
                               uint64_t mgmt_event, struct net_if *iface) {
  if (mgmt_event == NET_EVENT_WIFI_CONNECT_RESULT) {
    const struct wifi_status *st = (const struct wifi_status *)cb->info;
    int conn_status = st ? (int)st->conn_status : -1;
    LOG_INF("CONNECT_RESULT status=%d", conn_status);
    if (conn_status == WIFI_STATUS_CONN_SUCCESS) {
      k_sem_give(&wifi_connected);
    } else {
      LOG_ERR("WiFi fallo (status=%d) — reintentando en 5s", conn_status);
    }
  }
}

static void dhcp_event_handler(struct net_mgmt_event_callback *cb,
                               uint64_t mgmt_event, struct net_if *iface) {
  if (mgmt_event == NET_EVENT_IPV4_DHCP_BOUND) {
    struct in_addr *ip = &iface->config.dhcpv4.requested_ip;
    LOG_INF("DHCP BOUND: %d.%d.%d.%d", ip->s4_addr[0], ip->s4_addr[1],
            ip->s4_addr[2], ip->s4_addr[3]);
    k_sem_give(&ip_obtained);
  }
}

static void wifi_connect(void) {
  struct net_if *iface = net_if_get_default();

  net_mgmt_init_event_callback(&wifi_cb, wifi_event_handler,
                               NET_EVENT_WIFI_CONNECT_RESULT);
  net_mgmt_add_event_callback(&wifi_cb);

  net_mgmt_init_event_callback(&dhcp_cb, dhcp_event_handler,
                               NET_EVENT_IPV4_DHCP_BOUND |
                                   NET_EVENT_IPV4_DHCP_STOP);
  net_mgmt_add_event_callback(&dhcp_cb);

  struct wifi_connect_req_params params = {
      .ssid = CONFIG_WIFI_SSID,
      .ssid_length = strlen(CONFIG_WIFI_SSID),
      .psk = CONFIG_WIFI_PASSWORD,
      .psk_length = strlen(CONFIG_WIFI_PASSWORD),
      .security = WIFI_SECURITY_TYPE_PSK,
      .channel = WIFI_CHANNEL_ANY,
  };

  net_mgmt(NET_REQUEST_WIFI_CONNECT, iface, &params, sizeof(params));

  if (k_sem_take(&wifi_connected, K_SECONDS(30)) != 0) {
    LOG_ERR("No se pudo conectar al WiFi");
    return;
  }
  net_dhcpv4_stop(iface);
  net_dhcpv4_start(iface);

  if (k_sem_take(&ip_obtained, K_SECONDS(30)) != 0) {
    LOG_ERR("DHCP timeout — sin IP (dhcp_state=%d)",
            (int)iface->config.dhcpv4.state);
  }
}

// LittleFS

FS_LITTLEFS_DECLARE_DEFAULT_CONFIG(storage);
static struct fs_mount_t mp = {
    .type = FS_LITTLEFS,
    .fs_data = &storage,
    .mnt_point = "/lfs",
};

static void mount_lfs(void) {
  if (fs_mount(&mp) != 0) {
    LOG_ERR("No se pudo montar LittleFS");
    return;
  }
  LOG_INF("LittleFS montado en /lfs");
  fs_mkdir(ALARM_FOLDER);
}

// Helpers

static void compute_magnitude(const float *ax, const float *ay, const float *az,
                              float *mag, size_t n) {
  for (size_t i = 0; i < n; i++) {
    float x = ax[i], y = ay[i], z = az[i];
    mag[i] = sqrtf(x * x + y * y + z * z);
  }
}

// Función encargada de guardar las alarmas en LittleFS
static int save_alarm_zephyr(const char *report_json, const char *llm_json) {
  if (!report_json || !llm_json)
    return -1;

  cJSON *report_obj = cJSON_Parse(report_json);
  cJSON *llm_obj = cJSON_Parse(llm_json);

  if (!report_obj || !llm_obj) {
    if (report_obj)
      cJSON_Delete(report_obj);
    if (llm_obj)
      cJSON_Delete(llm_obj);
    return -1;
  }

  cJSON *root = cJSON_CreateObject();

  int64_t now = k_uptime_get();
  char alarm_id[64];
  snprintf(alarm_id, sizeof(alarm_id), "ALARM_%lld_%u", now, alarm_counter);
  alarm_counter++;

  cJSON_AddStringToObject(root, "id", alarm_id);
  cJSON_AddNumberToObject(root, "timestamp", (double)(now / 1000));
  cJSON_AddStringToObject(root, "type", "ALARM_TRIGGER");
  cJSON_AddItemToObject(root, "report", report_obj);
  cJSON_AddItemToObject(root, "llm", llm_obj);

  char *json_str = cJSON_Print(root);
  cJSON_Delete(root);
  if (!json_str)
    return -2;

  char filepath[128];
  snprintf(filepath, sizeof(filepath), "%s/%s.json", ALARM_FOLDER, alarm_id);

  struct fs_file_t f;
  fs_file_t_init(&f);
  if (fs_open(&f, filepath, FS_O_CREATE | FS_O_WRITE) != 0) {
    free(json_str);
    return -3;
  }

  fs_write(&f, json_str, strlen(json_str));
  fs_close(&f);
  free(json_str);
  return 0;
}

// main

int main(void) {
  // 1. Sistema de ficheros
  mount_lfs();

  // 2. WiFi — el agente necesita red para llamar a Gemini
  wifi_connect();

  // 3. Inicializar la simulación de los sensores
  sensors_init();

  // 4. Politica
  policy_t policy;
  policy_init(&policy);

  // 6. Config LLM desde Kconfig
  llm_config_t llm_cfg = {.gemini_url =
                              "https://generativelanguage.googleapis.com/"
                              "v1beta/models/%s:generateContent",
                          .gemini_model = "gemini-2.5-flash",
                          .gemini_api_key = CONFIG_GEMINI_API_KEY,
                          .timeout_ms = 90000};

  motor_state_t prev_state = MOTOR_OK;
  int prev_raw_anomaly = 0;

  while (1) {
    // a) Leer sensores
    float temp_c = 0.0f;
    sensors_read_temperature(&temp_c);
    sensors_read_vibration_window(ax, ay, az, N_SAMPLES, FS_HZ);

    // b) Features vibración
    compute_magnitude(ax, ay, az, mag, N_SAMPLES);
    vib_features_t fmag;
    vib_compute_features(mag, N_SAMPLES, &fmag);

    // c) Evaluar estado
    int allow_update = (policy.seen < policy.warmup_samples) ||
                       (prev_state == MOTOR_OK && !prev_raw_anomaly);
    motor_eval_t ev = policy_evaluate(&policy, temp_c, &fmag, allow_update);

    // d) Reporte JSON, usa k_uptime_get()/1000 como timestamp en segundos
    float rpm = 0.0f, load = 0.0f;
    sensors_get_context(&rpm, &load);

    char report_json[2048];
    long ts = (long)(k_uptime_get() / 1000);
    int ok = build_report_json(report_json, sizeof(report_json), DEVICE_ID, ts,
                               temp_c, &fmag, &ev, rpm, load);

    if (ok == 0) {
      LOG_INF("REPORT: %s", report_json);
    }

    // e) Flanco ALARM genera diagnóstico LLM
    int alarm_rising = (ev.state == MOTOR_ALARM) && (prev_state != MOTOR_ALARM);

    if (alarm_rising && ok == 0) {
      char *llm_json = NULL;
      int rc = llm_analyze_report(&llm_cfg, report_json, &llm_json);

      if (rc == 0 && llm_json) {
        int wr = save_alarm_zephyr(report_json, llm_json);
        if (wr != 0) {
          LOG_WRN("No pude guardar alarma (code=%d)", wr);
        } else {
          LOG_INF("ALARM -> diagnostico guardado en %s", ALARM_FOLDER);
        }
        free(llm_json);
      } else {
        const char *err_desc = "desconocido";
        if (rc == -20)
          err_desc = "GEMINI_API_KEY no configurada";
        else if (rc == -24)
          err_desc = "Error HTTP";
        else if (rc == -25)
          err_desc = "API key invalida";
        else if (rc == -26)
          err_desc = "Respuesta sin contenido";
        else if (rc == -27)
          err_desc = "JSON invalido";
        LOG_WRN("ALARM -> fallo Gemini (rc=%d: %s)", rc, err_desc);
        if (llm_json)
          free(llm_json);
      }
    }

    prev_state = ev.state;
    prev_raw_anomaly = ev.raw_anomaly;
    k_msleep(500); // 0.5 s entre reportes
  }

  return 0;
}
```

## src/baseline.c
```c
// baseline.c
#include "baseline.h"
#include <math.h>

void baseline_init(ewma_baseline_t *b, float alpha) {
    b->initialized = 0;
    b->alpha = alpha;
    b->mean = 0.0f;
    b->var = 0.0f;
}

void baseline_update(ewma_baseline_t *b, float x) {
    if (!b->initialized) {
        b->initialized = 1;
        b->mean = x;
        b->var = 1e-6f; // pequeña para evitar std=0
        return;
    }

    // EWMA de media
    float prev_mean = b->mean;
    b->mean = (1.0f - b->alpha) * b->mean + b->alpha * x;

    // EWMA de varianza (aprox): var <- (1-a)*var + a*(x-prev_mean)^2
    float d = x - prev_mean;
    b->var = (1.0f - b->alpha) * b->var + b->alpha * (d * d);

    if (b->var < 1e-8f) b->var = 1e-8f;
}

float baseline_std(const ewma_baseline_t *b) {
    return (b->initialized) ? sqrtf(b->var) : 0.0f;
}

float baseline_zscore(const ewma_baseline_t *b, float x) {
    if (!b->initialized) return 0.0f;
    float sd = baseline_std(b);
    if (sd < 1e-6f) return 0.0f;
    return (x - b->mean) / sd;
}
```

## src/baseline.h
```c
// baseline.h
#pragma once

typedef struct {
    int initialized;
    float alpha;    // 0.01..0.2 (más pequeño = más lento)
    float mean;
    float var;      // varianza EWMA
} ewma_baseline_t;

void baseline_init(ewma_baseline_t *b, float alpha);
void baseline_update(ewma_baseline_t *b, float x);
float baseline_std(const ewma_baseline_t *b);
float baseline_zscore(const ewma_baseline_t *b, float x);
```

## src/features.c
```c
// features.c
#include "features.h"
#include <math.h>

int vib_compute_features(const float *x, size_t n, vib_features_t *out) {
    if (!x || !out || n == 0) return -1;

    // 1) media
    double sum = 0.0;
    for (size_t i = 0; i < n; i++) sum += (double)x[i];
    double mean = sum / (double)n;

    // 2) RMS y peak
    double sum2 = 0.0;
    float peak = 0.0f;
    for (size_t i = 0; i < n; i++) {
        double v = (double)x[i];
        sum2 += v * v;
        float a = fabsf(x[i]);
        if (a > peak) peak = a;
    }
    double rms = sqrt(sum2 / (double)n);

    // 3) kurtosis = E[(x-mean)^4] / (E[(x-mean)^2]^2)
    // (Esto sube mucho con impactos tipo rodamiento)
    double m2 = 0.0;
    double m4 = 0.0;
    for (size_t i = 0; i < n; i++) {
        double d = (double)x[i] - mean;
        double d2 = d * d;
        m2 += d2;
        m4 += d2 * d2;
    }
    m2 /= (double)n;
    m4 /= (double)n;

    double kurt = 0.0;
    if (m2 > 1e-12) kurt = m4 / (m2 * m2);

    // crest factor = peak / rms
    float crest = 0.0f;
    if (rms > 1e-9) crest = (float)((double)peak / rms);

    out->mean = (float)mean;
    out->rms = (float)rms;
    out->peak = peak;
    out->crest = crest;
    out->kurtosis = (float)kurt;
    return 0;
}
```

## src/features.h
```c
// features.h
#pragma once
#include <stddef.h>

typedef struct {
    float mean;
    float rms;
    float peak;
    float crest;
    float kurtosis; // kurtosis (no exceso): ~3 en señal "gaussiana"
} vib_features_t;

// Calcula features básicas sobre un vector x[0..n-1]
int vib_compute_features(const float *x, size_t n, vib_features_t *out);
```

## src/llm_client.c
~~~~c
// llm_client.c — Cliente Gemini para Zephyr OS
// Sustituye libcurl por zsock (TLS) + http_client de Zephyr.
// La lógica cJSON (schema, prompt, parseo) es idéntica a la versión PC.
#include "llm_client.h"

#include <zephyr/kernel.h>
#include <zephyr/net/socket.h>
#include <zephyr/net/http/client.h>
#include <zephyr/logging/log.h>

#include <stdlib.h>
#include <string.h>
#include <stdio.h>

#include "cJSON.h"

LOG_MODULE_REGISTER(llm_client, LOG_LEVEL_INF);

#define GEMINI_HOST "generativelanguage.googleapis.com"
#define GEMINI_PORT 443

// Buffers estáticos para no fragmentar el heap en cada llamada al LLM
static uint8_t http_recv_buf[4096];
static char    g_response_body[8192];
static size_t  g_response_len = 0;
static char    g_body[6144];

// ---------------------------------------------------------------------------
// Callback HTTP — sustituye write_cb de curl
// http_client llama a esta función cada vez que llega un fragmento del body.
// Lo concatenamos en g_response_body para procesarlo entero al final.
// ---------------------------------------------------------------------------

static int response_cb(struct http_response *rsp,
                       enum http_final_call final_data,
                       void *user_data)
{
    (void)user_data;
    (void)final_data;
    if (rsp->body_frag_len > 0) {
        size_t copy = MIN(rsp->body_frag_len,
                          sizeof(g_response_body) - g_response_len - 1);
        memcpy(g_response_body + g_response_len, rsp->body_frag_start, copy);
        g_response_len += copy;
        g_response_body[g_response_len] = '\0';
    }
    return 0;
}

// ---------------------------------------------------------------------------
// Limpieza de markdown wrapping — sin cambios respecto a la versión PC
// ---------------------------------------------------------------------------

static char *strip_markdown_json(const char *text)
{
    if (!text) return NULL;

    const char *p = text;
    while (*p == ' ' || *p == '\t' || *p == '\n' || *p == '\r') p++;

    if (strncmp(p, "```json", 7) == 0) {
        p += 7;
    } else if (strncmp(p, "```", 3) == 0) {
        p += 3;
    } else {
        char *_r = malloc(strlen(text) + 1);
        if (_r) { strcpy(_r, text); }
        return _r;
    }

    while (*p == '\n' || *p == '\r') p++;

    const char *end = strstr(p, "```");
    size_t len;
    if (end) {
        const char *e = end;
        while (e > p && (*(e-1) == ' ' || *(e-1) == '\t' ||
                          *(e-1) == '\n' || *(e-1) == '\r')) e--;
        len = (size_t)(e - p);
    } else {
        len = strlen(p);
    }

    char *result = (char*)malloc(len + 1);
    if (!result) return NULL;
    memcpy(result, p, len);
    result[len] = '\0';
    return result;
}

// ---------------------------------------------------------------------------
// Socket TLS — sustituye curl_easy_init + CURLOPT_URL
// IPPROTO_TLS_1_2 le indica a Zephyr que use mbedTLS automáticamente.
// TLS_PEER_VERIFY_NONE omite la validación del certificado (válido para TFG).
// ---------------------------------------------------------------------------

static int open_tls_socket(void)
{
    int sock = zsock_socket(AF_INET, SOCK_STREAM, IPPROTO_TLS_1_2);
    if (sock < 0) {
        LOG_ERR("No se pudo crear socket TLS");
        return -1;
    }

    int verify = TLS_PEER_VERIFY_NONE;
    zsock_setsockopt(sock, SOL_TLS, TLS_PEER_VERIFY, &verify, sizeof(verify));
    zsock_setsockopt(sock, SOL_TLS, TLS_HOSTNAME, GEMINI_HOST, strlen(GEMINI_HOST));

    struct zsock_addrinfo hints = {
        .ai_family   = AF_INET,
        .ai_socktype = SOCK_STREAM,
    };
    struct zsock_addrinfo *res = NULL;

    if (zsock_getaddrinfo(GEMINI_HOST, "443", &hints, &res) != 0 || !res) {
        LOG_ERR("DNS fallo para %s", GEMINI_HOST);
        zsock_close(sock);
        return -1;
    }

    if (zsock_connect(sock, res->ai_addr, res->ai_addrlen) < 0) {
        LOG_ERR("Conexion TLS fallida (errno=%d)", errno);
        zsock_freeaddrinfo(res);
        zsock_close(sock);
        return -1;
    }

    zsock_freeaddrinfo(res);
    return sock;
}

// ---------------------------------------------------------------------------
// Llamada a Gemini
// ---------------------------------------------------------------------------

static int gemini_call(const llm_config_t *cfg,
                       const char *report_json,
                       char **out_llm_json)
{
    const char *api_key = cfg->gemini_api_key;
    if (!api_key || strlen(api_key) == 0) {
        LOG_ERR("GEMINI_API_KEY no configurada");
        return -20;
    }
    if (!cfg->gemini_model || !cfg->gemini_url) {
        LOG_ERR("gemini_model o gemini_url no configurados");
        return -20;
    }

    // URL path — la API key va como query param (igual que en la versión PC)
    char url_path[512];
    snprintf(url_path, sizeof(url_path),
             "/v1beta/models/%s:generateContent?key=%s",
             cfg->gemini_model, api_key);

    const char *system_instruction =
        "Experto en mantenimiento predictivo de motores industriales. "
        "Analiza telemetria (temp_c, temp_z, RMS, peak, kurtosis, crest, vib_z) "
        "y diagnostica fallos. Responde SOLO en JSON con: "
        "summary(1-3 palabras), "
        "diagnosis(BEARING_WEAR|MISALIGNMENT|IMBALANCE|THERMAL_ISSUE|UNKNOWN), "
        "confidence(0.0-1.0), severity(OK|WARN|ALARM), "
        "actions([{action,priority(NOW|24H|1W),params}]), "
        "report(parrafo con metricas reales y justificacion).";

    size_t prompt_len = strlen(report_json) + 128;
    char *user_prompt = (char*)malloc(prompt_len);
    if (!user_prompt) return -21;
    snprintf(user_prompt, prompt_len,
             "Analiza este reporte de motor y genera el diagnostico:\n\n%s",
             report_json);

    // ── Construir request body (cJSON — idéntico a la versión PC) ──
    cJSON *req = cJSON_CreateObject();

    cJSON *sys_inst  = cJSON_AddObjectToObject(req, "system_instruction");
    cJSON *sys_parts = cJSON_AddArrayToObject(sys_inst, "parts");
    cJSON *sys_part  = cJSON_CreateObject();
    cJSON_AddStringToObject(sys_part, "text", system_instruction);
    cJSON_AddItemToArray(sys_parts, sys_part);

    cJSON *contents = cJSON_AddArrayToObject(req, "contents");
    cJSON *turn     = cJSON_CreateObject();
    cJSON_AddStringToObject(turn, "role", "user");
    cJSON *parts  = cJSON_AddArrayToObject(turn, "parts");
    cJSON *part0  = cJSON_CreateObject();
    cJSON_AddStringToObject(part0, "text", user_prompt);
    cJSON_AddItemToArray(parts, part0);
    cJSON_AddItemToArray(contents, turn);

    cJSON *gen_config = cJSON_AddObjectToObject(req, "generationConfig");
    cJSON_AddStringToObject(gen_config, "responseMimeType", "application/json");

    cJSON_bool ok = cJSON_PrintPreallocated(req, g_body, sizeof(g_body), 0);
    cJSON_Delete(req);
    free(user_prompt);
    if (!ok) return -22;
    char *body = g_body;

    // ── Abrir socket TLS y enviar petición HTTP ──
    int sock = open_tls_socket();
    if (sock < 0) { return -23; }

    g_response_len = 0;

    const char *extra_headers[] = {
        "Content-Type: application/json\r\n",
        NULL
    };

    struct http_request http_req = {
        .method           = HTTP_POST,
        .url              = url_path,
        .host             = GEMINI_HOST,
        .protocol         = "HTTP/1.1",
        .payload          = body,
        .payload_len      = strlen(body),
        .response         = response_cb,
        .recv_buf         = http_recv_buf,
        .recv_buf_len     = sizeof(http_recv_buf),
        .optional_headers = extra_headers,
    };

    int ret = http_client_req(sock, &http_req, cfg->timeout_ms, NULL);
    zsock_close(sock);

    if (ret < 0) {
        LOG_ERR("http_client_req fallo: %d", ret);
        return -24;
    }
    if (g_response_len == 0) {
        LOG_ERR("Respuesta vacia de Gemini");
        return -24;
    }

    // ── Parsear respuesta — idéntico a la versión PC ──
    cJSON *root = cJSON_Parse(g_response_body);
    if (!root) {
        LOG_ERR("Respuesta no es JSON valido");
        return -25;
    }

    cJSON *error = cJSON_GetObjectItem(root, "error");
    if (error) {
        cJSON *msg  = cJSON_GetObjectItem(error, "message");
        cJSON *code = cJSON_GetObjectItem(error, "code");
        LOG_ERR("Error API Gemini (HTTP %d): %s",
                code  && cJSON_IsNumber(code)  ? code->valueint  : 0,
                msg   && cJSON_IsString(msg)   ? msg->valuestring : "desconocido");
        cJSON_Delete(root);
        return -25;
    }

    cJSON *cands = cJSON_GetObjectItem(root, "candidates");
    if (!cands || !cJSON_IsArray(cands) || cJSON_GetArraySize(cands) == 0) {
        LOG_ERR("No 'candidates' en respuesta");
        cJSON_Delete(root);
        return -26;
    }

    cJSON *c0      = cJSON_GetArrayItem(cands, 0);
    cJSON *content = c0     ? cJSON_GetObjectItem(c0, "content")      : NULL;
    cJSON *parts2  = content ? cJSON_GetObjectItem(content, "parts")  : NULL;

    if (!parts2 || !cJSON_IsArray(parts2) || cJSON_GetArraySize(parts2) == 0) {
        cJSON *finish = c0 ? cJSON_GetObjectItem(c0, "finishReason") : NULL;
        if (finish && cJSON_IsString(finish)) {
            LOG_ERR("Candidate bloqueado: finishReason=%s", finish->valuestring);
        } else {
            LOG_ERR("No 'parts' en candidate[0]");
        }
        cJSON_Delete(root);
        return -26;
    }

    cJSON *p0  = cJSON_GetArrayItem(parts2, 0);
    cJSON *txt = p0 ? cJSON_GetObjectItem(p0, "text") : NULL;

    if (!txt || !cJSON_IsString(txt) || !txt->valuestring) {
        LOG_ERR("No 'text' en parts[0]");
        cJSON_Delete(root);
        return -26;
    }

    char *cleaned = strip_markdown_json(txt->valuestring);
    cJSON_Delete(root);
    if (!cleaned) return -27;

    cJSON *llm_obj = cJSON_Parse(cleaned);
    free(cleaned);
    if (!llm_obj) {
        LOG_ERR("El texto de Gemini no es JSON valido");
        return -27;
    }

    char *out_json = cJSON_PrintUnformatted(llm_obj);
    cJSON_Delete(llm_obj);
    if (!out_json) return -28;

    *out_llm_json = out_json;
    return 0;
}

// ---------------------------------------------------------------------------
// Punto de entrada público
// ---------------------------------------------------------------------------

int llm_analyze_report(const llm_config_t *cfg,
                       const char *report_json,
                       char **out_llm_json)
{
    if (!cfg || !report_json || !out_llm_json) return -100;
    *out_llm_json = NULL;
    return gemini_call(cfg, report_json, out_llm_json);
}
~~~~

## src/llm_client.h
```c
// llm_client.h
#pragma once
#include <stddef.h>

typedef struct {
    // Google Gemini API
    const char *gemini_url;      // e.g. "https://generativelanguage.googleapis.com/v1beta/models/%s:generateContent"
    const char *gemini_model;    // e.g. "gemini-2.5-flash"
    const char *gemini_api_key;  // o NULL para leer env GEMINI_API_KEY

    long timeout_ms;             // HTTP timeout
} llm_config_t;

/**
 * Llama a Gemini con el reporte del motor.
 * Devuelve en out_llm_json un JSON (string) que es un objeto, o NULL si error.
 * El caller debe free(out_llm_json).
 *
 * return 0 OK, <0 error
 */
int llm_analyze_report(const llm_config_t *cfg,
                       const char *report_json,
                       char **out_llm_json);
```

## src/policy.c
```c
// policy.c
#include "policy.h"

void policy_init(policy_t *p) {
  baseline_init(
      &p->temp_base,
      0.05f); // alpha: adapta “en minutos” si reportas cada pocos segundos
  baseline_init(&p->vib_base, 0.05f);
  baseline_init(&p->kurt_base, 0.05f);
  baseline_init(&p->crest_base, 0.05f);

  p->warmup_samples = 15; // ~15 reportes para baseline inicial
  p->seen = 0;

  p->warn_z = 1.5f;
  p->alarm_z = 2.5f;

  // Umbrales absolutos
  p->temp_abs_warn = 80.0f;
  p->temp_abs_alarm = 95.0f;

  p->vib_abs_warn = 0.35f;
  p->vib_abs_alarm = 0.50f;

  // Curtosis
  p->kurt_abs_warn = 5.0f;
  p->kurt_abs_alarm = 8.0f;

  // Crest factor típico
  p->crest_abs_warn = 6.0f;
  p->crest_abs_alarm = 9.0f;

  // Persistencia: se necesitan ciertos ciclos consecutivos de anomalías para
  // elevar una alarma
  p->persist_needed = 5;
  p->persist_count = 0;
}

motor_eval_t policy_evaluate(policy_t *p, float temp_c,
                             const vib_features_t *vib,
                             int allow_baseline_update) {
  motor_eval_t ev;
  ev.state = MOTOR_OK;
  ev.raw_anomaly = 0;
  ev.temp_z = 0.0f;
  ev.vib_z = 0.0f;
  ev.kurt_z = 0.0f;
  ev.crest_z = 0.0f;
  ev.score = 0.0f;
  ev.reason = "ok";

  p->seen++;

  // Warmup: durante los primeros reportes, solo se construye el baseline.
  if (allow_baseline_update) {
    baseline_update(&p->temp_base, temp_c);
    baseline_update(&p->vib_base, vib->rms);
    baseline_update(&p->kurt_base, vib->kurtosis);
    baseline_update(&p->crest_base, vib->crest);
  }

  if (p->seen <= p->warmup_samples) {
    ev.state = MOTOR_OK;
    ev.reason = "warmup_baseline";
    return ev;
  }

  // zscores (desviación respecto al baseline)
  float tz = baseline_zscore(&p->temp_base, temp_c);
  float vz = baseline_zscore(&p->vib_base, vib->rms);
  float kz = baseline_zscore(&p->kurt_base, vib->kurtosis);
  float cz = baseline_zscore(&p->crest_base, vib->crest);

  ev.temp_z = tz;
  ev.vib_z = vz;
  ev.kurt_z = kz;
  ev.crest_z = cz;

  float score = tz;
  if (vz > score)
    score = vz;
  if (kz > score)
    score = kz;
  if (cz > score)
    score = cz;
  ev.score = score;

  // Reglas de severidad
  int alarm = 0, warn = 0;

  if (tz >= p->alarm_z || vz >= p->alarm_z || kz >= p->alarm_z ||
      cz >= p->alarm_z)
    alarm = 1;
  else if (tz >= p->warn_z || vz >= p->warn_z || kz >= p->warn_z ||
           cz >= p->warn_z)
    warn = 1;

  if (temp_c >= p->temp_abs_alarm || vib->rms >= p->vib_abs_alarm ||
      vib->kurtosis >= p->kurt_abs_alarm || vib->crest >= p->crest_abs_alarm)
    alarm = 1;
  else if (temp_c >= p->temp_abs_warn || vib->rms >= p->vib_abs_warn ||
           vib->kurtosis >= p->kurt_abs_warn || vib->crest >= p->crest_abs_warn)
    warn = 1;

  motor_state_t raw_state;
  if (alarm) {
    raw_state = MOTOR_ALARM;
    ev.reason = (temp_c >= p->temp_abs_alarm)          ? "temp_abs_alarm"
                : (vib->rms >= p->vib_abs_alarm)       ? "vib_abs_alarm"
                : (vib->kurtosis >= p->kurt_abs_alarm) ? "kurt_abs_alarm"
                : (vib->crest >= p->crest_abs_alarm)   ? "crest_abs_alarm"
                                                       : "z_alarm";
  } else if (warn) {
    raw_state = MOTOR_WARN;
    ev.reason = (temp_c >= p->temp_abs_warn)          ? "temp_abs_warn"
                : (vib->rms >= p->vib_abs_warn)       ? "vib_abs_warn"
                : (vib->kurtosis >= p->kurt_abs_warn) ? "kurt_abs_warn"
                : (vib->crest >= p->crest_abs_warn)   ? "crest_abs_warn"
                                                      : "z_warn";
  } else {
    raw_state = MOTOR_OK;
    ev.reason = "ok";
  }

  ev.raw_anomaly = (raw_state != MOTOR_OK);

  if (raw_state == MOTOR_OK) {
    p->persist_count = 0;
    ev.state = MOTOR_OK;
  } else {
    p->persist_count++;
    if (p->persist_count < p->persist_needed) {
      ev.state = MOTOR_OK;
    } else {
      ev.state = raw_state;
    }
  }

  return ev;
}
```

## src/policy.h
```c
// policy.h
#pragma once
#include "baseline.h"
#include "features.h"

typedef enum { MOTOR_OK = 0, MOTOR_WARN, MOTOR_ALARM } motor_state_t;

typedef struct {
  motor_state_t state;
  int raw_anomaly; // 1 si la evaluación cruda de ese ciclo fue warning o alarm
  float temp_z;
  float vib_z;
  float kurt_z;
  float crest_z;
  float score; // max(z) con signo (solo desviaciones por encima del baseline)
  const char *reason;
} motor_eval_t;

typedef struct {
  // Baselines
  ewma_baseline_t temp_base;
  ewma_baseline_t vib_base;   // Se usa vib_rms
  ewma_baseline_t kurt_base;  // curtosis de la magnitud de vibración
  ewma_baseline_t crest_base; // factor de cresta de la magnitud de vibración
  int warmup_samples;         // nº de reportes antes de confiar en zscore
  int seen;

  // Umbrales en z-score
  float warn_z;
  float alarm_z;

  // Umbrales absolutos de seguridad
  float temp_abs_warn;
  float temp_abs_alarm;
  float vib_abs_warn;
  float vib_abs_alarm;
  float kurt_abs_warn;
  float kurt_abs_alarm;
  float crest_abs_warn;
  float crest_abs_alarm;

  // Persistencia
  int persist_needed;
  int persist_count;
} policy_t;

void policy_init(policy_t *p);
motor_eval_t policy_evaluate(policy_t *p, float temp_c,
                             const vib_features_t *vib,
                             int allow_baseline_update);
```

## src/report.c
```c
// report.c
#include "report.h"
#include <stdio.h>

const char *motor_state_to_str(motor_state_t s) {
  switch (s) {
  case MOTOR_OK:
    return "OK";
  case MOTOR_WARN:
    return "WARN";
  case MOTOR_ALARM:
    return "ALARM";
  default:
    return "UNKNOWN";
  }
}

int build_report_json(char *out_buf, size_t out_sz, const char *device_id,
                      long ts, float temp_c, const vib_features_t *vib_mag,
                      const motor_eval_t *ev, float rpm, float load) {
  if (!out_buf || out_sz == 0 || !device_id || !vib_mag || !ev)
    return -1;

  int n = snprintf(out_buf, out_sz,
                   "{"
                   "\"device_id\":\"%s\","
                   "\"ts\":%ld,"
                   "\"context\":{"
                   "\"rpm\":%.1f,"
                   "\"load\":%.3f"
                   "},"
                   "\"sensors\":{"
                   "\"temp_c\":%.2f"
                   "},"
                   "\"vibration\":{"
                   "\"mag\":{"
                   "\"rms\":%.6f,"
                   "\"peak\":%.6f,"
                   "\"crest\":%.4f,"
                   "\"kurtosis\":%.4f"
                   "}"
                   "},"
                   "\"health\":{"
                   "\"state\":\"%s\","
                   "\"temp_z\":%.3f,"
                   "\"vib_z\":%.3f,"
                   "\"kurt_z\":%.3f,"
                   "\"crest_z\":%.3f,"
                   "\"score\":%.3f,"
                   "\"reason\":\"%s\""
                   "}"
                   "}",
                   device_id, ts, (double)rpm, (double)load, (double)temp_c,
                   (double)vib_mag->rms, (double)vib_mag->peak,
                   (double)vib_mag->crest, (double)vib_mag->kurtosis,
                   motor_state_to_str(ev->state), (double)ev->temp_z,
                   (double)ev->vib_z, (double)ev->kurt_z, (double)ev->crest_z,
                   (double)ev->score, ev->reason);

  return (n < 0 || (size_t)n >= out_sz) ? -2 : 0;
}
```

## src/report.h
```c
// report.h
#pragma once
#include "features.h"
#include "policy.h"
#include <stddef.h>

const char* motor_state_to_str(motor_state_t s);

// Construye un JSON en out_buf (sin librerías externas).
// Devuelve 0 si OK.
int build_report_json(char *out_buf, size_t out_sz,
                      const char *device_id,
                      long ts,
                      float temp_c,
                      const vib_features_t *vib_mag,
                      const motor_eval_t *ev,
                      float rpm,
                      float load);
```

## src/sensors.c
```c
#include "sensors.h"
#include <math.h>
#include <stdbool.h>
#include <zephyr/kernel.h>
#include <zephyr/logging/log.h>

LOG_MODULE_REGISTER(sensors, LOG_LEVEL_INF);

#ifndef M_PI
#define M_PI 3.14159265358979323846
#endif

// Tipos internos de simulación

typedef enum {
  SIM_FAULT_NONE = 0,
  SIM_FAULT_IMBALANCE,
  SIM_FAULT_MISALIGNMENT,
  SIM_FAULT_BEARING_WEAR
} sim_fault_t;

typedef struct {
  float rpm;
  float load_0_1;
  sim_fault_t fault;
  float severity_0_1;
} sim_profile_t;

typedef struct {
  uint32_t rng;
  sim_profile_t profile;
  float t;
  float temp_base_c;
  float temp_trend_c;
} sim_state_t;

static sim_state_t g;

// RNG (xorshift32)

static uint32_t xorshift32(uint32_t *state) {
  uint32_t x = *state;
  x ^= x << 13;
  x ^= x >> 17;
  x ^= x << 5;
  *state = x;
  return x;
}

static float rand_u01(void) { return (xorshift32(&g.rng) / 4294967296.0f); }

static float rand_uniform(float a, float b) { return a + (b - a) * rand_u01(); }

static float rand_gauss_approx(float mean, float std) {
  float s = 0.0f;
  for (int i = 0; i < 6; i++)
    s += rand_u01();
  s = (s - 3.0f);
  return mean + std * s;
}

// Componente de fallo (firma de vibración)

static float fault_component(float t, float f_rot_hz, sim_fault_t fault,
                             float sev) {
  float x = 0.0f;

  switch (fault) {
  case SIM_FAULT_IMBALANCE:
    x += (0.35f * sev) * sinf(2.0f * (float)M_PI * f_rot_hz * t);
    break;

  case SIM_FAULT_MISALIGNMENT:
    x += (0.20f * sev) * sinf(2.0f * (float)M_PI * (2.0f * f_rot_hz) * t);
    x += (0.08f * sev) * sinf(2.0f * (float)M_PI * (3.0f * f_rot_hz) * t);
    break;

  case SIM_FAULT_BEARING_WEAR: {
    float f_def = 5.0f * f_rot_hz;
    float phase = fmodf(f_def * t, 1.0f);
    float spike = (phase < 0.02f) ? (1.0f - (phase / 0.02f)) : 0.0f;
    x += (0.6f * sev) * spike;
    x += rand_gauss_approx(0.0f, 0.08f * sev);
    break;
  }

  default:
    break;
  }

  return x;
}

// API pública

static const char *fault_to_str(sim_fault_t fault) {
  switch (fault) {
  case SIM_FAULT_NONE:
    return "NONE";
  case SIM_FAULT_IMBALANCE:
    return "IMBALANCE";
  case SIM_FAULT_MISALIGNMENT:
    return "MISALIGNMENT";
  case SIM_FAULT_BEARING_WEAR:
    return "BEARING_WEAR";
  default:
    return "UNKNOWN";
  }
}

void sensors_init(void) {
  // Se usa k_uptime_get() como semilla para que cada arranque dé datos
  // distintos
  uint32_t seed = (uint32_t)(k_uptime_get() & 0xFFFFFFFF);
  g.rng = (seed == 0 ? 0xA5A5A5A5u : seed);

  // Perfil de la simulación para obtener datos concretos
  g.profile.rpm = 1500.0f;
  g.profile.load_0_1 = 0.65f;
  g.profile.fault = SIM_FAULT_NONE;
  g.profile.severity_0_1 = 0.0f;

  g.t = 0.0f;
  g.temp_base_c = 45.0f;
  g.temp_trend_c = 0.0f;

  LOG_INF("Sensores inicializados (simulacion: %s sev=%.1f)",
          fault_to_str(g.profile.fault), (double)g.profile.severity_0_1);
}

int sensors_read_temperature(float *temp_c) {
  if (!temp_c)
    return -1;

  float load = g.profile.load_0_1;
  float sev = g.profile.severity_0_1;

  g.temp_trend_c += rand_gauss_approx(0.0f, 0.002f);
  if (g.temp_trend_c < -5.0f)
    g.temp_trend_c = -5.0f;
  if (g.temp_trend_c > 8.0f)
    g.temp_trend_c = 8.0f;

  float fault_heat = 0.0f;
  if (g.profile.fault == SIM_FAULT_BEARING_WEAR)
    fault_heat = 12.0f * sev;
  if (g.profile.fault == SIM_FAULT_MISALIGNMENT)
    fault_heat = 6.0f * sev;
  if (g.profile.fault == SIM_FAULT_IMBALANCE)
    fault_heat = 3.0f * sev;

  *temp_c = g.temp_base_c + 20.0f * load + fault_heat + g.temp_trend_c +
            rand_gauss_approx(0.0f, 0.15f);

  return 0;
}

int sensors_read_vibration_window(float *ax, float *ay, float *az,
                                  size_t n_samples, float sample_rate_hz) {
  if (!ax || !ay || !az || n_samples == 0 || sample_rate_hz <= 0.0f)
    return -1;

  float dt = 1.0f / sample_rate_hz;
  float f_rot_hz = g.profile.rpm / 60.0f;
  float load = g.profile.load_0_1;
  float sev = g.profile.severity_0_1;
  float base_amp = 0.08f + 0.25f * load;

  float ax_scale = rand_uniform(0.90f, 1.10f);
  float ay_scale = rand_uniform(0.90f, 1.10f);
  float az_scale = rand_uniform(0.90f, 1.10f);

  for (size_t i = 0; i < n_samples; i++) {
    float t = g.t + (float)i * dt;

    float normal =
        base_amp * sinf(2.0f * (float)M_PI * f_rot_hz * t) +
        (0.25f * base_amp) * sinf(2.0f * (float)M_PI * (2.0f * f_rot_hz) * t) +
        0.02f * sinf(2.0f * (float)M_PI * 180.0f * t);

    float noise = rand_gauss_approx(0.0f, 0.02f + 0.01f * load);
    float fault = fault_component(t, f_rot_hz, g.profile.fault, sev);
    float sample = normal + noise + fault;

    ax[i] = ax_scale * sample + rand_gauss_approx(0.0f, 0.01f);
    ay[i] = ay_scale * (0.85f * sample) + rand_gauss_approx(0.0f, 0.01f);
    az[i] = az_scale * (0.60f * sample) + rand_gauss_approx(0.0f, 0.01f);
  }

  g.t += (float)n_samples * dt;
  return 0;
}

void sensors_get_context(float *rpm, float *load) {
  if (rpm)
    *rpm = g.profile.rpm;
  if (load)
    *load = g.profile.load_0_1;
}
```

## src/sensors.h
```c
#pragma once
#include <stddef.h>
#include <stdint.h>

#ifdef __cplusplus
extern "C" {
#endif

// Inicializa el módulo de sensores.

void sensors_init(void);

int sensors_read_temperature(float *temp_c);

int sensors_read_vibration_window(float *ax, float *ay, float *az,
                                  size_t n_samples, float sample_rate_hz);

void sensors_get_context(float *rpm, float *load);

#ifdef __cplusplus
}
#endif
```
